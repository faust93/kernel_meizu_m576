## drivers/input/fingerprint/Kconfig
```kconfig
#
# Input fingerprint drivers configuration
#
menuconfig INPUT_FINGERPRINT
	bool "FingerPrint devices"
        default y
	help
	  Say Y here, and a list of fingerprint input drivers will be displayed.
	  Everything that didn't fit into the other categories is here. This option
	  doesn't affect the kernel.

	  If unsure, say Y.

if INPUT_FINGERPRINT

config INPUT_FINGERPRINT_FPC
	tristate "FPC fingerprint support"
        default y
	help
	  Say Y here if you have a FPC fingerprint device and want to enable
	  support for the built-in touchscreen.

	  If unsure, say N.

source "drivers/input/fingerprint/fpc/Kconfig"

endif
```

## drivers/input/fingerprint/fpc/Kconfig
```kconfig
#
# Goodix GT9xx Touchscreen driver
#

config FINGERPRINT_FPC_FPC1020_FAMILY
	tristate "FPC1020 Family fingerprint driver"
	depends on INPUT_FINGERPRINT_FPC
	default y
	help
	  This is the driver for FPC1020 family fingerprint

	  Say Y here if you have a FPC1020 family fingerprint connected
	  to your system.

	  If unsure, say N.
```
